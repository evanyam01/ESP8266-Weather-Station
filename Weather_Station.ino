#include <ESP8266WiFi.h>
#include <ESP8266HTTPClient.h>
#include <ESP8266WebServer.h>
#include <DNSServer.h>
#include <WiFiManager.h>
#include <WiFiClient.h>
#include <NTPClient.h>
#include <WiFiUdp.h>
#include <time.h>
#include <Adafruit_GFX.h>
#include <Adafruit_SSD1306.h>
#include <ArduinoJson.h>
#include <Adafruit_NeoPixel.h>
#include <math.h>

//definitions for wifi
const char* ssid = "";                   // SSID of local network
const char* password = "";  // Password on network

int currentState;

//definitions for OpenWeatherMap
String APIKEY = "";
String CityID = "";
String units = "imperial";
String lat;
String lon;
String baseURL = "http://api.openweathermap.org/data/2.5/weather?id=";
String urlForecast = "http://api.openweathermap.org/data/2.5/forecast?id=" + CityID + "&cnt=25&appid=" + APIKEY;
String urlCurrent = baseURL + CityID + "&units=" + units + "&APPID=" + APIKEY;
const char* cityName;
String weather;
const char* weatherDesc;
String temp;
float timezone;
int tempMin;
int tempMax;
String weatherDescriptions[3];
int weatherDescriptionsDT[3];

//definitions for time
WiFiUDP ntpUDP;
NTPClient timeClient(ntpUDP);
String weekDays[7] = { "Sun", "Mon", "Tue", "Wed", "Thu", "Fri", "Sat" };
String formattedTime;
int dayStamp;
String timeStamp;
String weekDay;
String nextDays[3];
String timeOfDay;
unsigned long refreshTime;
unsigned long changeState;

//function defintions
void getHTTP();
void getTime();
void displayCurrent();
void displayForecast();
void displayMiddle(String str);
void drawCat();

//weather symbols
// 'Rain', 24x24px
const unsigned char Rain_Sym[] PROGMEM = {
  0x01, 0xf0, 0x00, 0x03, 0xf8, 0x70, 0x06, 0x0c, 0xf8, 0x1c, 0x07, 0x8c, 0x38, 0x03, 0x06, 0x60,
  0x00, 0x03, 0xc0, 0x00, 0x03, 0xc0, 0x00, 0x03, 0xc0, 0x00, 0x03, 0xe0, 0x00, 0x07, 0x7f, 0xff,
  0xfe, 0x3f, 0xff, 0xfc, 0x00, 0x00, 0x00, 0x00, 0x00, 0x00, 0x10, 0x84, 0x21, 0x21, 0x08, 0x42,
  0x42, 0x10, 0x84, 0x84, 0x21, 0x08, 0x00, 0x00, 0x00, 0x00, 0x00, 0x00, 0x10, 0x84, 0x21, 0x21,
  0x08, 0x42, 0x42, 0x10, 0x84, 0x84, 0x21, 0x08
};

// 'Cloudy_Sym', 24x24px
const unsigned char Cloudy_Sym[] PROGMEM = {
  0x00, 0x00, 0x00, 0x00, 0x00, 0x00, 0x00, 0xe0, 0x00, 0x01, 0xf0, 0xe0, 0x03, 0x19, 0xf0, 0x0e,
  0x0f, 0x1c, 0x1c, 0x06, 0x0e, 0x30, 0x00, 0x03, 0x60, 0x00, 0x03, 0x61, 0xc0, 0x03, 0x63, 0xe1,
  0xc3, 0x36, 0x33, 0xe6, 0x3c, 0x1e, 0x3c, 0x78, 0x0c, 0x1c, 0xe0, 0x00, 0x06, 0xc0, 0x00, 0x06,
  0xc0, 0x00, 0x06, 0xc0, 0x00, 0x06, 0xe0, 0x00, 0x0c, 0x7f, 0xff, 0xf8, 0x3f, 0xff, 0xf0, 0x00,
  0x00, 0x00, 0x00, 0x00, 0x00, 0x00, 0x00, 0x00
};

// 'Clear_Daylight_Sym', 24x24px
const unsigned char Clear_Daylight_Sym[] PROGMEM = {
  0x00, 0x18, 0x00, 0x00, 0x18, 0x00, 0x10, 0x18, 0x08, 0x38, 0x00, 0x1c, 0x1c, 0x3c, 0x38, 0x08,
  0xff, 0x10, 0x01, 0xc1, 0x80, 0x03, 0x00, 0xc0, 0x06, 0x00, 0x60, 0x06, 0x00, 0x60, 0x0c, 0x00,
  0x30, 0xec, 0x00, 0x37, 0xec, 0x00, 0x37, 0x0c, 0x00, 0x30, 0x06, 0x00, 0x60, 0x06, 0x00, 0x60,
  0x03, 0x00, 0xc0, 0x01, 0xc3, 0x80, 0x08, 0xff, 0x10, 0x1c, 0x3c, 0x38, 0x38, 0x00, 0x1c, 0x10,
  0x18, 0x08, 0x00, 0x18, 0x00, 0x00, 0x18, 0x00
};

// 'Thunderstorm', 24x24px
const unsigned char Thunderstorm_Sym[] PROGMEM = {
  0x01, 0xf0, 0x00, 0x03, 0xf8, 0x70, 0x06, 0x0c, 0xf8, 0x1c, 0x07, 0x8c, 0x38, 0x03, 0x06, 0x60,
  0x00, 0x03, 0xc0, 0x00, 0x03, 0xc0, 0x00, 0x03, 0xc0, 0x00, 0x03, 0xe0, 0x00, 0x07, 0x7f, 0xff,
  0xfe, 0x3f, 0xff, 0xfc, 0x00, 0x00, 0x00, 0x10, 0x1e, 0x02, 0x20, 0x24, 0x04, 0x40, 0x48, 0x08,
  0xf8, 0x9f, 0x9f, 0x11, 0x00, 0x82, 0x21, 0xfd, 0x04, 0x40, 0x0a, 0x08, 0x80, 0x14, 0x10, 0x00,
  0x28, 0x00, 0x00, 0x50, 0x00, 0x00, 0x60, 0x00
};

// 'Snow', 24x24px
const unsigned char Snow_Sym[] PROGMEM = {
  0x01, 0xf0, 0x00, 0x03, 0x18, 0x70, 0x06, 0x0c, 0xf8, 0x1c, 0x07, 0x8c, 0x38, 0x03, 0x06, 0x60,
  0x00, 0x03, 0xc0, 0x00, 0x03, 0xc0, 0x00, 0x03, 0xc0, 0x00, 0x03, 0xe0, 0x00, 0x07, 0x7f, 0xff,
  0xfe, 0x3f, 0xff, 0xfc, 0x00, 0x00, 0x00, 0xa0, 0x50, 0x20, 0x40, 0x20, 0xa8, 0xa0, 0x50, 0x70,
  0x00, 0x01, 0xfc, 0x04, 0x00, 0x70, 0x15, 0x00, 0xa8, 0x0e, 0x00, 0x20, 0x3f, 0x80, 0x00, 0x0e,
  0x0a, 0x05, 0x15, 0x04, 0x02, 0x04, 0x0a, 0x05
};

// 'Process1_Sym', 8x8px
const unsigned char Process1_Sym[] PROGMEM = {
  0x00, 0x18, 0x00, 0x01, 0x99, 0x80, 0x01, 0x81, 0x80, 0x08, 0x00, 0x10, 0x18, 0x00, 0x18, 0x00,
  0x00, 0x00, 0x00, 0x00, 0x00, 0x60, 0x00, 0x06, 0x60, 0x00, 0x06, 0x00, 0x00, 0x00, 0x00, 0x00,
  0x00, 0xc0, 0x00, 0x03, 0xc0, 0x00, 0x03, 0x00, 0x00, 0x00, 0x00, 0x00, 0x00, 0x60, 0x00, 0x06,
  0x60, 0x00, 0x06, 0x00, 0x00, 0x00, 0x00, 0x00, 0x00, 0x18, 0x00, 0x18, 0x08, 0x00, 0x10, 0x01,
  0x81, 0x80, 0x01, 0x99, 0x80, 0x00, 0x18, 0x00
};

// 'Process2_Sym', 8x8px
const unsigned char Process2_Sym[] PROGMEM = {
  0x00, 0x66, 0x00, 0x00, 0x66, 0x00, 0x06, 0x00, 0x60, 0x06, 0x00, 0x60, 0x00, 0x00, 0x00, 0x30,
  0x00, 0x0c, 0x30, 0x00, 0x0c, 0x00, 0x00, 0x00, 0x00, 0x00, 0x00, 0xc0, 0x00, 0x03, 0xc0, 0x00,
  0x03, 0x00, 0x00, 0x00, 0x00, 0x00, 0x00, 0xc0, 0x00, 0x03, 0xc0, 0x00, 0x03, 0x00, 0x00, 0x00,
  0x00, 0x00, 0x00, 0x30, 0x00, 0x0c, 0x30, 0x00, 0x0c, 0x00, 0x00, 0x00, 0x06, 0x00, 0x60, 0x06,
  0x00, 0x60, 0x00, 0x66, 0x00, 0x00, 0x66, 0x00
};

//definitions for wifimanager
const char* apName = "";
String apNamestr = apName;

//WS2812b Setup
Adafruit_NeoPixel strip = Adafruit_NeoPixel(1, D4);

//OLED Display Setup
Adafruit_SSD1306 display(128, 64, &Wire, -1);

void setup() {
  Serial.begin(115200);
  delay(200);

  strip.begin();  //tell strip to start taking data
  strip.show();   //set all leds to 'off'

  WiFi.disconnect(true, true);
  Serial.println("MAC Address: " + WiFi.macAddress());

  // SSD1306_SWITCHCAPVCC = generate display voltage from 3.3V internally
  display.begin(SSD1306_SWITCHCAPVCC, 0x3C);
  delay(200);
  display.clearDisplay();
  display.setTextSize(1);
  display.setTextColor(SSD1306_WHITE);
  display.setRotation(2);
  display.setCursor(0, 0);

  /*
  //setup wifimanager page, comment this out if ssid and password is already known
  WiFiManager wifiManager;
  Serial.println("Opening WiFiManager");
  display.print("Connect Weather Buddy to wifi by opening  wifi on phone, and   selecting: " + apNamestr);
  display.display();
  wifiManager.autoConnect(apName);
  Serial.println("WiFiManager Connected");
  display.clearDisplay();
  display.print("Connected");
  display.display();
  */

  //comment this out if ssid and password isn't know
  Serial.print("Connecting to WiFi");
  WiFi.begin(ssid, password);
  while (WiFi.status() != WL_CONNECTED) {
    Serial.print(".");

    display.clearDisplay();
    display.setTextSize(1);
    display.setTextColor(WHITE);
    display.setCursor(20, 15);
    display.println("Connect to WiFi");
    display.drawBitmap(52, 25, Process1_Sym, 24, 24, WHITE);
    display.drawRect(0, 0, 128, 64, WHITE);
    display.display();
    delay(250);

    display.clearDisplay();
    display.setTextSize(1);
    display.setTextColor(WHITE);
    display.setCursor(20, 15);
    display.println("Connect to WiFi");
    display.drawBitmap(52, 25, Process2_Sym, 24, 24, WHITE);
    display.drawRect(0, 0, 128, 64, WHITE);
    display.display();
    delay(250);
  }

  Serial.println("");

  display.clearDisplay();
  displayMiddle("Connected!");
  delay(1000);
  display.clearDisplay();
  display.display();

  Serial.println("Connected to WiFi");

  timeClient.begin();
  timeClient.setTimeOffset(-28800);

  /*
  Serial.println("");
  Serial.println("Good" + timeOfDay + " Here's the weather for today:");
  Serial.println("Weather: " + weather);
  Serial.println("Current Temperature: " + temp + "°F");
  Serial.print("Max Temperature: ");
  Serial.print(tempMax);
  Serial.println("°F");
  Serial.print("Min Temperature: ");
  Serial.print(tempMin);
  Serial.println("°F");
  Serial.println("");

  Serial.println("Forecast for next 3 days: ");
  for (int i = 0; i < 3; i++) {
    Serial.print("Weather for ");
    Serial.print(nextDays[i]);
    Serial.print(": ");
    Serial.println(weatherDescriptions[i]);
  }
  */

  //call functions to get next 3 days and weather descriptions
  getInfo();

  //turn Neopixel off
  strip.setPixelColor(1, strip.Color(0, 0, 0));
  strip.show();

  currentState = 0;
  changeState = millis();
}

void getHTTP() {
  // Make the HTTP request
  WiFiClient client;
  HTTPClient http;

  // Use the new begin method
  http.begin(client, urlCurrent);
  int httpCode = http.GET();  // Make the request
  Serial.println("Updating HTTP");

  DynamicJsonDocument doc(16000);

  if (httpCode > 0) {                   // Check the returning code
    String payload = http.getString();  // Get the request response payload
    DeserializationError error = deserializeJson(doc, payload);
    if (error) {
      Serial.print(F("deserializeJson() for urlCurrent failed: "));
      Serial.println(error.f_str());
      return;
    }
  }

  Serial.println("HTTP Updated");

  //assign variables to current weather http grab
  cityName = doc["name"];
  lat = doc["coord"]["lat"].as<String>();
  lon = doc["coord"]["lon"].as<String>();
  weather = doc["weather"][0]["main"].as<String>();
  weatherDesc = doc["weather"][0]["description"];
  temp = doc["main"]["temp"].as<String>();
  tempMin = doc["main"]["temp_min"].as<int>();
  tempMax = doc["main"]["temp_max"].as<int>();
  timezone = doc["timezone"].as<float>();

  //Serial.println(weather);

  //Serial.println(cityName);
  http.end();  // Close connection

  //get forecast
  http.begin(client, urlForecast);
  httpCode = http.GET();

  if (httpCode > 0) {                   // Check the returning code
    String payload = http.getString();  // Get the request response payload
    //Serial.println(payload);
    DeserializationError error = deserializeJson(doc, payload);
    if (error) {
      Serial.print(F("deserializeJson() for urlForecast failed: "));
      Serial.println(error.f_str());
      return;
    }

    for (int i = 1; i < 4; i++) {
      weatherDescriptions[i - 1] = doc["list"][i * 8]["weather"][0]["main"].as<String>();
      weatherDescriptionsDT[i - 1] = doc["list"][i * 8]["dt"].as<int>();
      //Serial.println(weatherDescriptionsDT[i-1]);
      //Serial.println(weatherDescriptions[i-1]);
    }
  }

  http.end();
}

void getTime() {
  Serial.println("Updatting timeClient");
  timeClient.update();
  time_t epochTime = timeClient.getEpochTime();
  formattedTime = timeClient.getFormattedTime();
  Serial.println("timeClient Updatted");
  //Serial.println("Formatted Time: " + formattedTime);
  struct tm* ptm = gmtime((time_t*)&epochTime);
  int monthDay = ptm->tm_mday;
  int splitT = formattedTime.indexOf("T");
  dayStamp = timeClient.getDay();
  //Serial.print("DAY: ");
  weekDay = weekDays[dayStamp];

  //set time of day to morning or afternoon
  struct tm* timeInfo;
  timeInfo = localtime(&epochTime);
  if (timeInfo->tm_hour < 12) {
    //Serial.println("morning");
    timeOfDay = "morning";
  } else {
    //Serial.println("afternoon");
    timeOfDay = "afternoon";
  }

  //array out of bounds handling
  if (dayStamp == 0 || dayStamp == 1 || dayStamp == 2 || dayStamp == 3) {
    nextDays[0] = weekDays[dayStamp + 1];
    nextDays[1] = weekDays[dayStamp + 2];
    nextDays[2] = weekDays[dayStamp + 3];
  } else if (dayStamp == 4) {
    nextDays[0] = weekDays[dayStamp + 1];
    nextDays[1] = weekDays[dayStamp + 2];
    nextDays[2] = weekDays[0];
  } else if (dayStamp == 5) {
    nextDays[0] = weekDays[dayStamp + 1];
    nextDays[1] = weekDays[0];
    nextDays[2] = weekDays[1];
  } else if (dayStamp == 6) {
    nextDays[0] = weekDays[0];
    nextDays[1] = weekDays[1];
    nextDays[2] = weekDays[2];
  }

  /*
  for (int i = 0; i < 3; i++) {
    Serial.println(nextDays[i]);
  }
  */
  //Serial.println(weekDay);
  //Serial.print("Month day: ");
  //Serial.println(monthDay);
}

void displayCurrent() {
  display.clearDisplay();

  if (weather == "Clouds") {
    display.drawBitmap(11, 3, Cloudy_Sym, 24, 24, WHITE);
  } else if (weather == "Clear") {
    display.drawBitmap(11, 3, Clear_Daylight_Sym, 24, 24, WHITE);
  } else if (weather == "Rain" || weather == "Drizzle") {
    display.drawBitmap(11, 3, Rain_Sym, 24, 24, WHITE);
  } else if (weather == "Thunderstorm") {
    display.drawBitmap(11, 3, Thunderstorm_Sym, 24, 24, WHITE);
  } else if (weather == "Snow") {
    display.drawBitmap(11, 3, Snow_Sym, 24, 24, WHITE);
  }


  display.setCursor(0, 29);
  display.print(temp + (char)247 + "F");
  display.setCursor(2, 50);
  display.print(tempMin);
  display.print("-");
  display.print(tempMax);
  display.print((char)247);
  display.print("F");
  display.setCursor(57, 49);
  display.print(weekDays[dayStamp]);
  display.setCursor(49, 12);
  display.print("Good" + timeOfDay);
  display.setCursor(69, 25);
  display.print("Kiana!");

  display.drawLine(44, 1, 44, 41, WHITE);
  display.drawLine(2, 44, 126, 44, WHITE);
  display.drawLine(50, 46, 50, 61, WHITE);
  display.drawLine(83, 46, 83, 61, WHITE);

  display.display();
}

void displayForecast() {
  int x1 = 0;
  int y1 = 20;
  int x2 = 42;
  int y2 = 20;
  int x3 = 84;
  int y3 = 20;
  int x;
  int y;

  display.clearDisplay();

  for (int i = 0; i < 3; i++) {
    if (weatherDescriptions[i] == "Clouds") {
      if (i == 0) {
        x = x1;
        y = y1;
        display.drawBitmap(x, y, Cloudy_Sym, 24, 24, WHITE);  //--> display.drawBitmap(x position, y position, bitmap data, bitmap width, bitmap height, color);
        display.setCursor(x + 2, y + 28);
        display.print(nextDays[i]);
      }
      if (i == 1) {
        x = x2;
        y = y2;
        display.drawBitmap(x, y, Cloudy_Sym, 24, 24, WHITE);  //--> display.drawBitmap(x position, y position, bitmap data, bitmap width, bitmap height, color);
        display.setCursor(x + 2, y + 28);
        display.print(nextDays[i]);
      }
      if (i == 2) {
        x = x3;
        y = y3;
        display.drawBitmap(x, y, Cloudy_Sym, 24, 24, WHITE);  //--> display.drawBitmap(x position, y position, bitmap data, bitmap width, bitmap height, color);
        display.setCursor(x + 2, y + 28);
        display.print(nextDays[i]);
      }
    }
    if (weatherDescriptions[i] == "Rain") {
      if (i == 0) {
        x = x1;
        y = y1;
        display.drawBitmap(x, y, Rain_Sym, 24, 24, WHITE);  //--> display.drawBitmap(x position, y position, bitmap data, bitmap width, bitmap height, color);
        display.setCursor(x + 2, y + 28);
        display.print(nextDays[i]);
      }
      if (i == 1) {
        x = x2;
        y = y2;
        display.drawBitmap(x, y, Rain_Sym, 24, 24, WHITE);  //--> display.drawBitmap(x position, y position, bitmap data, bitmap width, bitmap height, color);
        display.setCursor(x + 2, y + 28);
        display.print(nextDays[i]);
      }
      if (i == 2) {
        x = x3;
        y = y3;
        display.drawBitmap(x, y, Rain_Sym, 24, 24, WHITE);  //--> display.drawBitmap(x position, y position, bitmap data, bitmap width, bitmap height, color);
        display.setCursor(x + 2, y + 28);
        display.print(nextDays[i]);
      }
    }
    if (weatherDescriptions[i] == "Clear") {
      if (i == 0) {
        x = x1;
        y = y1;
        display.drawBitmap(x, y, Clear_Daylight_Sym, 24, 24, WHITE);  //--> display.drawBitmap(x position, y position, bitmap data, bitmap width, bitmap height, color);
        display.setCursor(x + 2, y + 28);
        display.print(nextDays[i]);
      }
      if (i == 1) {
        x = x2;
        y = y2;
        display.drawBitmap(x, y, Clear_Daylight_Sym, 24, 24, WHITE);  //--> display.drawBitmap(x position, y position, bitmap data, bitmap width, bitmap height, color);
        display.setCursor(x + 2, y + 28);
        display.print(nextDays[i]);
      }
      if (i == 2) {
        x = x3;
        y = y3;
        display.drawBitmap(x, y, Clear_Daylight_Sym, 24, 24, WHITE);  //--> display.drawBitmap(x position, y position, bitmap data, bitmap width, bitmap height, color);
        display.setCursor(x + 2, y + 28);
        display.print(nextDays[i]);
      }
    }
    if (weatherDescriptions[i] == "Snow") {
      if (i == 0) {
        x = x1;
        y = y1;
        display.drawBitmap(x, y, Snow_Sym, 24, 24, WHITE);  //--> display.drawBitmap(x position, y position, bitmap data, bitmap width, bitmap height, color);
        display.setCursor(x + 2, y + 28);
        display.print(nextDays[i]);
      }
      if (i == 1) {
        x = x2;
        y = y2;
        display.drawBitmap(x, y, Snow_Sym, 24, 24, WHITE);  //--> display.drawBitmap(x position, y position, bitmap data, bitmap width, bitmap height, color);
        display.setCursor(x + 2, y + 28);
        display.print(nextDays[i]);
      }
      if (i == 2) {
        x = x3;
        y = y3;
        display.drawBitmap(x, y, Snow_Sym, 24, 24, WHITE);  //--> display.drawBitmap(x position, y position, bitmap data, bitmap width, bitmap height, color);
        display.setCursor(x + 2, y + 28);
        display.print(nextDays[i]);
      }
    }
    if (weatherDescriptions[i] == "Thunderstorm") {
      if (i == 0) {
        x = x1;
        y = y1;
        display.drawBitmap(x, y, Thunderstorm_Sym, 24, 24, WHITE);  //--> display.drawBitmap(x position, y position, bitmap data, bitmap width, bitmap height, color);
        display.setCursor(x + 2, y + 28);
        display.print(nextDays[i]);
      }
      if (i == 1) {
        x = x2;
        y = y2;
        display.drawBitmap(x, y, Thunderstorm_Sym, 24, 24, WHITE);  //--> display.drawBitmap(x position, y position, bitmap data, bitmap width, bitmap height, color);
        display.setCursor(x + 2, y + 28);
        display.print(nextDays[i]);
      }
      if (i == 2) {
        x = x3;
        y = y3;
        display.drawBitmap(x, y, Thunderstorm_Sym, 24, 24, WHITE);  //--> display.drawBitmap(x position, y position, bitmap data, bitmap width, bitmap height, color);
        display.setCursor(x + 2, y + 28);
        display.print(nextDays[i]);
      }
    }
  }

  display.display();
}

void displayMiddle(String str) {
  int16_t x;
  int16_t y;
  uint16_t x1;
  uint16_t y1;
  display.getTextBounds(str, 0, 0, &x, &y, &x1, &y1);
  display.setCursor(64 - x1 / 2, 32 - y1 / 2);
  display.print(str);
  display.display();
}

const unsigned char cat[] PROGMEM = {
  0x00, 0x00, 0x00, 0x00, 0x00, 0x00, 0x07, 0xff, 0xc0, 0x00, 0x00, 0x00, 0x00, 0x00, 0x00, 0x00,
  0x00, 0x00, 0x00, 0x00, 0x00, 0x0f, 0xff, 0xc7, 0xff, 0x80, 0x00, 0x00, 0x00, 0x00, 0x00, 0x00,
  0x00, 0x00, 0x00, 0x3e, 0x00, 0xfc, 0x00, 0x00, 0x01, 0xf8, 0x00, 0x00, 0x00, 0x00, 0x00, 0x00,
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  0x00, 0x00, 0x00, 0x00, 0x00, 0x00, 0x00, 0x1f, 0x80, 0x00, 0x00, 0x00, 0x00, 0x00, 0x00, 0x00
};

void drawCat() {
  display.clearDisplay();
  display.drawBitmap(0, 0, cat, 128, 64, WHITE);
  display.display();
}

void getInfo() {
  getTime();
  getHTTP();
  refreshTime = millis();
}

  void loop() {
  //change display
  if (millis() >= changeState + 10000) {
    if (currentState < 2) {
      currentState++;
    } else {
      currentState = 0;
    }
    changeState = millis();
  }

  if (millis() >= refreshTime + 600000) {
    getInfo();
  }

  if (currentState == 0) {
    displayCurrent();
  } else if (currentState == 1) {
    displayForecast();
  } else if (currentState == 2) {
    drawCat();
  }
}
